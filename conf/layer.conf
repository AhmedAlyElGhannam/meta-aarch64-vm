## conf/layer.conf
```bitbake
# We have a conf and classes directory, add to BBPATH
BBPATH .= ":${LAYERDIR}"

# We have recipes-* directories, add to BBFILES
BBFILES += "${LAYERDIR}/recipes-*/*/*.bb \
            ${LAYERDIR}/recipes-*/*/*.bbappend"

BBFILE_COLLECTIONS += "meta-aarch64-vm"
BBFILE_PATTERN_meta-aarch64-vm = "^${LAYERDIR}/"
BBFILE_PRIORITY_meta-aarch64-vm = "6"

LAYERDEPENDS_meta-aarch64-vm = "core"
LAYERSERIES_COMPAT_meta-aarch64-vm = "scarthgap"
```
